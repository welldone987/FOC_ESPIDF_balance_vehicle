## components/Middlewares/Kconfig.projbuild
```kconfig
menu "Vehicle Wi-Fi telemetry"

    # station连接使用的网络名称；空值会使Wi-Fi初始化返回参数错误。
    config VEHICLE_WIFI_SSID
        string "Wi-Fi station SSID"
        default ""

    # station连接使用的密码；空值表示开放网络。
    config VEHICLE_WIFI_PASSWORD
        string "Wi-Fi station password"
        default ""

    # TCP遥测监听端口，service()只接受一个客户端连接。
    config VEHICLE_WIFI_TELEMETRY_PORT
        int "TCP telemetry port"
        range 1 65535
        default 3333

endmenu
```

## tests/diagnostics/sdkconfig.defaults
```kconfig
CONFIG_IDF_TARGET="esp32"
CONFIG_FREERTOS_HZ=1000
CONFIG_ESPTOOLPY_FLASHSIZE_4MB=y
```
